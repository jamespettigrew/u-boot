## fs/cramfs/Kconfig
```kconfig
config FS_CRAMFS
	bool "Enable CRAMFS filesystem support"
	help
	  This provides support for reading images fromCRAMFS (Compressed ROM
	  filesystem). CRAMFS is useful when space is tight since files are
	  compressed. You can also enable CMD_CRAMFS to get command-line
	  access.
```
